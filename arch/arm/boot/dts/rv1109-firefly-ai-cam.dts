// SPDX-License-Identifier: (GPL-2.0+ OR MIT)
/*
 * Copyright (c) 2020 Rockchip Electronics Co., Ltd.
 */
/dts-v1/;
#include "rv1109.dtsi"
#include "rv1109-firefly-ai-cam.dtsi"
#include "rv1109-firefly-npu-opp.dtsi"
/ {
	model = "Firefly CAM-CRV1109S2U Board";
	compatible = "rockchip,rv1109-ai-cam-ddr3L-v1", "rockchip,rv1109";
};


